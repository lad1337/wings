## zmk/config/boards/shields/wings/Kconfig.defconfig
```kconfig
# Copyright (c) 2020 The ZMK Contributors
# SPDX-License-Identifier: MIT

if SHIELD_WINGS_DONGLE

config ZMK_KEYBOARD_NAME
	default "wings Dongle"
	
config ZMK_SPLIT_BLE_ROLE_CENTRAL
	default y
	
config ZMK_USB
	default y

endif

if SHIELD_WINGS_LEFT || SHIELD_WINGS_RIGHT || SHIELD_WINGS_DONGLE 

config ZMK_SPLIT
	default y

config ZMK_BLE
	default y
	
endif
```

## zmk/config/boards/shields/wings/Kconfig.shield
```kconfig
# Copyright (c) 2020 The ZMK Contributors
# SPDX-License-Identifier: MIT

config SHIELD_WINGS_LEFT
	def_bool $(shields_list_contains,wings_left)

config SHIELD_WINGS_RIGHT
	def_bool $(shields_list_contains,wings_right)

config SHIELD_WINGS_DONGLE
	def_bool $(shields_list_contains,wings_dongle)
```
